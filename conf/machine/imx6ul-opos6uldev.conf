## conf/machine/imx6ul-opos6uldev.conf
```bitbake
#@TYPE: Machine
#@NAME: IMX6UL-OPOS6ULDEV
#@SOC: i.MX6UL
#@DESCRIPTION: Machine configuration for IMX6UL-OPOS6ULDEV board.
#@MAINTAINER: Maxime Borgs <maxime.borges@strataggem.com>

MACHINEOVERRIDES =. "mx6:mx6ul:"

include conf/machine/include/imx-base.inc
include conf/machine/include/tune-cortexa7.inc

MACHINE_FEATURES += "wifi"

SERIAL_CONSOLE = "115200 ttymxc7"

PREFERRED_PROVIDER_virtual/kernel ?= "linux-fslc"
KERNEL_DEVICETREE = "imx6ul-opos6uldev.dtb"

UBOOT_MACHINE ?= "opos6uldev_defconfig"

MACHINE_ESSENTIAL_EXTRA_RDEPENDS += " \
    kernel-image \
    kernel-devicetree \
"
```
